## config/west.yml
```yaml
manifest:
  remotes:
    - name: zmkfirmware
      url-base: https://github.com/zmkfirmware
    - name: 280Zo
      url-base: https://github.com/280Zo
  projects:
    - name: zmk
      remote: zmkfirmware
      revision: main
      import: app/west.yml
    - name: zmk-pmw3610-driver
      remote: 280Zo
      revision: main
#    - name: zmk-split-peripheral-input-relay
#      remote: badjeff
#      revision: main
    - name: prospector-zmk-module
      remote: 280Zo
      revision: main
  self:
    path: config
# manifest:
#   remotes:
#     - name: zmkfirmware
#       url-base: https://github.com/zmkfirmware
#     # Additional modules containing boards/shields/custom code can be listed here as well
#     # See https://docs.zephyrproject.org/3.2.0/develop/west/manifest.html#projects
#   projects:
#     - name: zmk
#       remote: zmkfirmware
#       revision: main
#       import: app/west.yml
#   self:
#     path: config
```
